## guest-build/buildroot-external/Config.in
```kconfig
config BR2_DOSAI_CONFIG_PROOF_ONLY
	bool
	default y
	help
	  Marks the DOSAI toolchain provider fixture as configuration-only.
	  Build and source-fetch goals are rejected by external.mk.
```

## guest-build/buildroot-external/configs/dosai_toolchain_proof_defconfig
```kconfig
BR2_DOSAI_CONFIG_PROOF_ONLY=y
BR2_aarch64=y
BR2_TOOLCHAIN_BUILDROOT_MUSL=y
BR2_STATIC_LIBS=y
BR2_PACKAGE_HOST_GO=y
BR2_PACKAGE_HOST_GO_SRC=y
# BR2_PACKAGE_HOST_GO_BIN is not set
```
